GPIO_PORTB_DATA 	EQU 0x400053FC ; data addr e s s to a l l pins
GPIO_PORTB_DIR 		EQU 0x40005400
GPIO_PORTB_AFSEL 	EQU 0x40005420
GPIO_PORTB_DEN 		EQU 0x4000551C
GPIO_PORTB_PUR 		EQU 0x40005510
PUB					EQU 0xF0
IOB 				EQU 0x0F
GPIO_PORTE_DATA 	EQU 0x400243FC ; data addr e s s to a l l pins
GPIO_PORTE_DIR 		EQU 0x40024400
GPIO_PORTE_AFSEL 	EQU 0x40024420
GPIO_PORTE_DEN 		EQU 0x4002451C
IOE 				EQU 0x00
SYSCTL_RCGCGPIO 	EQU 0x400FE608
	
			AREA main, READONLY, CODE, ALIGN=2
			THUMB
			EXTERN __delay
			EXPORT __main

__main 	LDR R1,=SYSCTL_RCGCGPIO
		LDR R0,[R1]
		ORR R0,R0,#0x12
		STR R0,[R1]
		NOP
		NOP
		NOP 

		LDR R1,=GPIO_PORTB_DIR 
		LDR R0,[R1]
		BIC R0,#0xFF
		ORR R0,#IOB
		STR R0,[R1]
		LDR R1,=GPIO_PORTB_AFSEL
		LDR R0,[R1]
		BIC R0,#0xFF
		STR R0,[R1]
		LDR R1,=GPIO_PORTB_DEN
		LDR R0,[R1]
		ORR R0,#0xFF
		STR R0,[R1] ; c o n f i g . o f por t B ends
		
		LDR R0,=GPIO_PORTB_PUR
		MOV	R1,#PUB
		STR R1,[R0]
		
		MOV32 R11,#4500000
input
		MOV32 R11,#4500000
		LDR R2,=0
		LDR R3,=0
		LDR R1,=GPIO_PORTB_DATA
		LDRB R4,[R1]
		ASR	R4,R4,#4
		CMP R4,#0xF
		BEQ input
		
		MOV R2,R1
		LDRB R2,[R2]
		ASR	R3,R2,#4
		STR	R3,[R1]
		BL __delay
		B input
		ALIGN
		END